## arch/riscv/cpu/dubhe/Kconfig
```kconfig
# SPDX-License-Identifier: GPL-2.0+
#
# Copyright (c) 2021 StarFive Technology Co., Ltd.

config STARFIVE_DUBHE
	bool
	select SUPPORT_SPL
	select BINMAN if SPL
	select ARCH_EARLY_INIT_R
	imply CPU
	imply CPU_RISCV
	imply RISCV_TIMER if (RISCV_SMODE || SPL_RISCV_SMODE)
	imply SIFIVE_CLINT if RISCV_MMODE
	imply SPL_RISCV_ACLINT
	imply CMD_CPU
	imply SPL_CPU
	imply SPL_OPENSBI
	imply SPL_LOAD_FIT
	imply SMP
	imply MII

config SYS_CACHELINE_SIZE
	default 64
```

## arch/riscv/cpu/fu540/Kconfig
```kconfig
# SPDX-License-Identifier: GPL-2.0+
#
# Copyright (C) 2018, Bin Meng <bmeng.cn@gmail.com>

config SIFIVE_FU540
	bool
	select ARCH_EARLY_INIT_R
	select SUPPORT_SPL
	select RAM
	select SPL_RAM if SPL
	imply CPU
	imply CPU_RISCV
	imply RISCV_TIMER if (RISCV_SMODE || SPL_RISCV_SMODE)
	imply SPL_SIFIVE_CLINT
	imply CMD_CPU
	imply SPL_CPU
	imply SPL_OPENSBI
	imply SPL_LOAD_FIT
	imply SMP
	imply CLK_SIFIVE
	imply CLK_SIFIVE_PRCI
	imply SIFIVE_SERIAL
	imply MACB
	imply MII
	imply SPI
	imply SPI_SIFIVE
	imply MMC
	imply MMC_SPI
	imply MMC_BROKEN_CD
	imply CMD_MMC
	imply DM_GPIO
	imply SIFIVE_GPIO
	imply CMD_GPIO
	imply MISC
	imply SIFIVE_OTP
	imply DM_PWM
	imply PWM_SIFIVE
	imply DM_I2C
	imply SYS_I2C_OCORES

if ENV_IS_IN_SPI_FLASH

config ENV_OFFSET
	default 0x505000

config ENV_SIZE
	default 0x20000

config ENV_SECT_SIZE
	default 0x10000

endif # ENV_IS_IN_SPI_FLASH

config SIFIVE_FU540_L2CC_FLUSH
	bool "Support Level 2 Cache Controller Flush operation of SiFive fu540"

menu "Level 2 Cache Controller Flush range"
	depends on SIFIVE_FU540_L2CC_FLUSH

config SIFIVE_FU540_L2CC_FLUSH_START
	hex "Level 2 Cache Flush operation start"
	default 0x80000000

config SIFIVE_FU540_L2CC_FLUSH_SIZE
	hex "Level 2 Cache Flush operation size"
	default 0x800000000

endmenu # SIFIVE_FU540_L2CC_FLUSH

config SIFIVE_FU540_L2CC_WAYENABLE_DIY
	bool "Config Level 2 Cache Controller: the largest way which has been enabled"

menu "The index of the largest way"
	depends on SIFIVE_FU540_L2CC_WAYENABLE_DIY

config SIFIVE_FU540_L2CC_WAYENABLE_DIY_NUM
	int "The index of the largest way which has been enabled for level 2 Cache "
	default 1
	range 0 255
	help
	  Range[0, 255]. The index of the largest way which has been enabled.

endmenu # SIFIVE_FU540_L2CC_WAYENABLE_DIY
```

## arch/riscv/cpu/fu740/Kconfig
```kconfig
# SPDX-License-Identifier: GPL-2.0+
#
# Copyright (C) 2020-2021 SiFive, Inc
# Pragnesh Patel <pragnesh.patel@sifive.com>

config SIFIVE_FU740
	bool
	select ARCH_EARLY_INIT_R
	select RAM
	select SPL_RAM if SPL
	imply CPU
	imply CPU_RISCV
	imply RISCV_TIMER if (RISCV_SMODE || SPL_RISCV_SMODE)
	imply SPL_SIFIVE_CLINT
	imply CMD_CPU
	imply SPL_CPU
	imply SPL_OPENSBI
	imply SPL_LOAD_FIT
	imply SMP
	imply CLK_SIFIVE
	imply CLK_SIFIVE_PRCI
	imply SIFIVE_SERIAL
	imply MACB
	imply MII
	imply SPI
	imply SPI_SIFIVE
	imply MMC
	imply MMC_SPI
	imply MMC_BROKEN_CD
	imply CMD_MMC
	imply DM_GPIO
	imply SIFIVE_GPIO
	imply CMD_GPIO
	imply MISC
	imply SIFIVE_OTP
	imply DM_PWM
	imply PWM_SIFIVE
	imply DM_I2C
	imply SYS_I2C_OCORES
	imply SPL_I2C

config SIFIVE_FU740_L2CC_FLUSH
	bool "Support Level 2 Cache Controller Flush operation of SiFive fu740"

menu "Level 2 Cache Controller Flush range"
	depends on SIFIVE_FU740_L2CC_FLUSH

config SIFIVE_FU740_L2CC_FLUSH_START
	hex "Level 2 Cache Flush operation start"
	default 0x80000000

config SIFIVE_FU740_L2CC_FLUSH_SIZE
	hex "Level 2 Cache Flush operation size"
	default 0x800000000

endmenu # SIFIVE_FU740_L2CC_FLUSH

config SIFIVE_FU740_L2CC_WAYENABLE_DIY
	bool "Config Level 2 Cache Controller: the largest way which has been enabled"

menu "The index of the largest way"
	depends on SIFIVE_FU740_L2CC_WAYENABLE_DIY

config SIFIVE_FU740_L2CC_WAYENABLE_DIY_NUM
	int "The index of the largest way which has been enabled for level 2 Cache "
	default 1
	range 0 255
	help
	  Range[0, 255]. The index of the largest way which has been enabled.

endmenu # SIFIVE_FU740_L2CC_WAYENABLE_DIY
```

## board/starfive/dubhe_fpga/Kconfig
```kconfig
if TARGET_STARFIVE_DUBHE_FPGA

config SYS_CPU
	default "dubhe"

config SYS_BOARD
	default "dubhe_fpga"

config SYS_VENDOR
	default "starfive"

config SYS_SOC
	default "dubhe_fpga_soc"

config SYS_CONFIG_NAME
	default "starfive-dubhe-fpga"

config TEXT_BASE
	default 0x80200000 if SPL
	default 0x80000000 if !RISCV_SMODE
	default 0x80200000 if RISCV_SMODE

config SPL_TEXT_BASE
	default 0x80000000

config SPL_OPENSBI_LOAD_ADDR
	default 0x80100000

config BOARD_SPECIFIC_OPTIONS # dummy
	def_bool y
	select STARFIVE_DUBHE
	select SUPPORT_SPL
	select BINMAN
	imply DM_SERIAL
	imply SIFIVE_SERIAL
	imply CMD_SF

endif
```

## board/starfive/vic7100/Kconfig
```kconfig
if TARGET_STARFIVE_VIC7100

config SYS_CPU
	default "fu540"

config SYS_BOARD
	default "vic7100"

config SYS_VENDOR
	default "starfive"

config SYS_SOC
	default "vic7100"

config SYS_CONFIG_NAME
	default "starfive-vic7100"

config ENV_SIZE
	default 0x2000 if ENV_IS_IN_SPI_FLASH

config ENV_OFFSET
	default 0x140000 if ENV_IS_IN_SPI_FLASH

config SYS_TEXT_BASE
	default 0x80200000 if SPL
	default 0x80000000 if !RISCV_SMODE
	default 0x80200000 if RISCV_SMODE

config SPL_TEXT_BASE
	default 0x08000000

config SPL_OPENSBI_LOAD_ADDR
	default 0x80000000

config CACHE_WAYENABLE
	tristate "L2 cache wayenable"
	default n
	help
	  L2 cache wayenable.

config BOARD_SPECIFIC_OPTIONS # dummy
	def_bool y
	select SIFIVE_FU540
#	select ENV_IS_IN_SPI_FLASH
	imply CMD_DHCP
	imply CMD_EXT2
	imply CMD_EXT4
	imply CMD_FAT
	imply CMD_FS_GENERIC
	imply CMD_GPT
	imply PARTITION_TYPE_GUID
	imply CMD_NET
	imply CMD_PING
	imply CMD_SF
	imply DOS_PARTITION
	imply EFI_PARTITION
	imply IP_DYN
	imply ISO_PARTITION
	imply PHY_LIB
	imply PHY_MSCC
	imply SPI_FLASH
	imply SPI_FLASH_ISSI
	imply SYSRESET
	imply SYSRESET_GPIO
	imply CMD_DHCP

endif
```

## configs/pinetab_defconfig
```kconfig
CONFIG_ARM=y
CONFIG_ARCH_SUNXI=y
CONFIG_SPL=y
CONFIG_MACH_SUN50I=y
CONFIG_SUNXI_DRAM_LPDDR3_STOCK=y
CONFIG_DRAM_CLK=552
CONFIG_DRAM_ZQ=3881949
CONFIG_MMC_SUNXI_SLOT_EXTRA=2
CONFIG_R_I2C_ENABLE=y
CONFIG_SPL_SPI_SUNXI=y
# CONFIG_SYS_MALLOC_CLEAR_ON_INIT is not set
CONFIG_USE_PREBOOT=y
# CONFIG_SPL_DOS_PARTITION is not set
# CONFIG_SPL_EFI_PARTITION is not set
CONFIG_DEFAULT_DEVICE_TREE="sun50i-a64-pinetab"
CONFIG_OF_LIST="sun50i-a64-pinetab"
CONFIG_SYS_RELOC_GD_ENV_ADDR=y
CONFIG_DM_REGULATOR=y
CONFIG_DM_REGULATOR_FIXED=y
CONFIG_DM_PWM=y
CONFIG_PWM_SUNXI=y
CONFIG_LED=y
CONFIG_LED_GPIO=y
CONFIG_USB_EHCI_HCD=y
CONFIG_USB_OHCI_HCD=y
CONFIG_SYS_USB_EVENT_POLL_VIA_INT_QUEUE=y
```

## configs/starfive_dubhe_fpga_defconfig
```kconfig
CONFIG_RISCV=y
CONFIG_SYS_MALLOC_F_LEN=0x3000
CONFIG_NR_DRAM_BANKS=1
CONFIG_SPL_DM_SPI=y
CONFIG_DEFAULT_DEVICE_TREE="dubhe_fpga"
CONFIG_SPL=y
CONFIG_SPL_SPI_FLASH_SUPPORT=y
CONFIG_SPL_SPI_SUPPORT=y
CONFIG_TARGET_STARFIVE_DUBHE_FPGA=y
CONFIG_ARCH_RV64I=y
CONFIG_RISCV_SMODE=y
# CONFIG_SPL_SMP is not set
CONFIG_FIT=y
CONFIG_USE_BOOTARGS=y
CONFIG_BOOTARGS="console=ttySIF0,115200 earlycon=sbi root=/dev/mmcblk0p2 rw rootfstype=ext4 rootwait"
CONFIG_USE_BOOTCOMMAND=y
CONFIG_BOOTCOMMAND="echo Dubhe FPGA booting from serial flash...; sf probe 1:0; sf read 0x84000000 0x400000 0x1200000; bootm 0x84000000"
CONFIG_SPL_SEPARATE_BSS=y
CONFIG_SPL_DM_SPI_FLASH=y
CONFIG_SPL_SPI_LOAD=y
CONFIG_SYS_SPI_U_BOOT_OFFS=0x22000
CONFIG_CMD_MTD=y
CONFIG_CMD_MTDPARTS=y
CONFIG_SYS_RELOC_GD_ENV_ADDR=y
CONFIG_SPL_CLK=y
CONFIG_DM_MTD=y
CONFIG_SF_DEFAULT_BUS=1
CONFIG_SF_DEFAULT_SPEED=20000000
CONFIG_SPI_FLASH_BAR=y
CONFIG_SPI_FLASH_GIGADEVICE=y
CONFIG_SPI_FLASH_ISSI=y
CONFIG_SPI_FLASH_MACRONIX=y
CONFIG_SPI_FLASH_SPANSION=y
CONFIG_SPI_FLASH_STMICRO=y
CONFIG_SPI_FLASH_WINBOND=y
CONFIG_SPI_FLASH_MTD=y
CONFIG_RAM=y
CONFIG_SPL_RAM=y
CONFIG_SPI=y
CONFIG_SPI_SIFIVE=y
```

## configs/starfive_evb_defconfig
```kconfig
CONFIG_RISCV=y
CONFIG_SYS_MALLOC_F_LEN=0x8000
CONFIG_NR_DRAM_BANKS=1
CONFIG_SPL_DM_SPI=y
CONFIG_DEFAULT_DEVICE_TREE="starfive_evb"
CONFIG_SPL_MMC_SUPPORT=y
CONFIG_SPL=y
CONFIG_SPL_SPI_FLASH_SUPPORT=y
CONFIG_SPL_SPI_SUPPORT=y
CONFIG_BUILD_TARGET=""
CONFIG_TARGET_STARFIVE_EVB=y
CONFIG_NR_CPUS=5
CONFIG_FPGA_GMAC_SPEED_AUTO=y
CONFIG_ARCH_RV64I=y
CONFIG_CMODEL_MEDANY=y
CONFIG_RISCV_SMODE=y
CONFIG_SHOW_REGS=y
CONFIG_FIT=y
CONFIG_SPL_FIT_SOURCE="jh7110-uboot-fit-image.its"
CONFIG_SUPPORT_RAW_INITRD=y
CONFIG_QSPI_BOOT=y
CONFIG_SD_BOOT=y
CONFIG_SPI_BOOT=y
CONFIG_USE_BOOTARGS=y
CONFIG_BOOTARGS="console=ttyS0,115200  debug rootwait  earlycon=sbi"
CONFIG_USE_BOOTCOMMAND=y
CONFIG_LOG_MAX_LEVEL=4
CONFIG_SPL_LOG=y
CONFIG_DISPLAY_CPUINFO=y
CONFIG_DISPLAY_BOARDINFO=y
CONFIG_DISPLAY_BOARDINFO_LATE=y
CONFIG_MISC_INIT_R=y
CONFIG_SYS_MMCSD_RAW_MODE_U_BOOT_USE_SECTOR=y
CONFIG_SYS_MMCSD_RAW_MODE_U_BOOT_SECTOR=0x1800
CONFIG_SPL_DM_SPI_FLASH=y
CONFIG_SPL_SPI_LOAD=y
CONFIG_HUSH_PARSER=y
CONFIG_SYS_PROMPT="StarFive # "
CONFIG_CMD_CONFIG=y
CONFIG_CMD_GPT_RENAME=y
CONFIG_CMD_MISC=y
CONFIG_CMD_PART=y
CONFIG_CMD_USB=y
CONFIG_CMD_TFTPPUT=y
CONFIG_CMD_SYSBOOT=y
CONFIG_CMD_EXT4_WRITE=y
CONFIG_CMD_FS_UUID=y
CONFIG_CMD_LOG=y
CONFIG_OF_EMBED=y
CONFIG_VERSION_VARIABLE=y
CONFIG_NET_RANDOM_ETHADDR=y
CONFIG_SPL_CLK_COMPOSITE_CCF=y
CONFIG_CLK_CCF=y
CONFIG_CLK_COMPOSITE_CCF=y
CONFIG_SPL_CLK_JH7110=y
CONFIG_MMC_DW=y
CONFIG_MMC_DW_SNPS=y
CONFIG_SF_DEFAULT_MODE=0x0
CONFIG_SF_DEFAULT_SPEED=50000000
CONFIG_SPI_FLASH_GIGADEVICE=y
CONFIG_SPI_FLASH_SPANSION=y
CONFIG_PHY_MARVELL=y
CONFIG_PHY_YUTAI=y
CONFIG_DWC_ETH_QOS=y
CONFIG_DWC_ETH_QOS_STARFIVE=y
CONFIG_RGMII=y
CONFIG_RAM=y
CONFIG_SPL_RAM=y
# CONFIG_RAM_SIFIVE is not set
CONFIG_SPL_STARFIVE_DDR=y
CONFIG_DM_RESET=y
CONFIG_SPECIFY_CONSOLE_INDEX=y
CONFIG_SYS_NS16550=y
CONFIG_SPI=y
CONFIG_CADENCE_QSPI=y
CONFIG_USB=y
CONFIG_USB_XHCI_HCD=y
CONFIG_USB_CDNS3=y
CONFIG_USB_CDNS3_HOST=y
CONFIG_USB_STORAGE=y
CONFIG_OF_LIBFDT_OVERLAY=y
# CONFIG_EFI_UNICODE_COLLATION_PROTOCOL2 is not set
# CONFIG_EFI_LOAD_FILE2_INITRD is not set
```

## configs/starfive_jh7100_beagle_v_smode_defconfig
```kconfig
CONFIG_RISCV=y
CONFIG_SYS_MALLOC_F_LEN=0x3000
CONFIG_NR_DRAM_BANKS=1
CONFIG_SYS_MALLOC_LEN=0x800000
# CONFIG_DM_GPIO is not set
CONFIG_DEFAULT_DEVICE_TREE="starfive_jh7100_beagle_v"
CONFIG_SYS_CLK_FREQ=1000000000
CONFIG_TARGET_STARFIVE_JH7100=y
CONFIG_JH_BEAGLE_V=y
CONFIG_SIFIVE_FU540_L2CC_FLUSH=y
CONFIG_SIFIVE_FU540_L2CC_WAYENABLE_DIY=y
CONFIG_SIFIVE_FU540_L2CC_WAYENABLE_DIY_NUM=16
CONFIG_ARCH_RV64I=y
CONFIG_RISCV_SMODE=y
CONFIG_SHOW_REGS=y
# CONFIG_CC_OPTIMIZE_FOR_SIZE is not set
CONFIG_DISTRO_DEFAULTS=y
CONFIG_SYS_BOOT_GET_CMDLINE=y
CONFIG_SYS_BOOT_GET_KBD=y
CONFIG_FIT=y
CONFIG_QSPI_BOOT=y
CONFIG_SD_BOOT=y
CONFIG_SPI_BOOT=y
CONFIG_AUTOBOOT_KEYED=y
CONFIG_AUTOBOOT_DELAY_STR="f"
CONFIG_AUTOBOOT_STOP_STR="v"
CONFIG_AUTOBOOT_KEYED_CTRLC=y
CONFIG_USE_BOOTARGS=y
CONFIG_BOOTARGS="console=ttyS0,115200 debug rootwait earlycon stmmaceth=chain_mode:1"
CONFIG_BOOTCOMMAND="run bootcmd_mmc0"
CONFIG_USE_PREBOOT=y
CONFIG_PREBOOT="setenv fdt_addr ${fdtcontroladdr};fdt addr ${fdtcontroladdr};"
CONFIG_SYS_CONSOLE_INFO_QUIET=y
CONFIG_LOG_MAX_LEVEL=5
CONFIG_DISPLAY_CPUINFO=y
CONFIG_MISC_INIT_R=y
CONFIG_SYS_PROMPT="BeagleV # "
CONFIG_CMD_CONFIG=y
CONFIG_CMD_LICENSE=y
CONFIG_CMD_SBI=y
CONFIG_CMD_BOOTZ=y
# CONFIG_BOOTM_NETBSD is not set
# CONFIG_BOOTM_PLAN9 is not set
# CONFIG_BOOTM_RTEMS is not set
# CONFIG_BOOTM_VXWORKS is not set
CONFIG_CMD_MEMINFO=y
CONFIG_CMD_STRINGS=y
# CONFIG_CMD_LZMADEC is not set
# CONFIG_CMD_UNZIP is not set
CONFIG_CMD_CLK=y
# CONFIG_CMD_DM is not set
# CONFIG_CMD_GPIO is not set
# CONFIG_RANDOM_UUID is not set
CONFIG_CMD_GPT_RENAME=y
CONFIG_CMD_LSBLK=y
CONFIG_CMD_TFTPPUT=y
# CONFIG_CMD_MII is not set
CONFIG_CMD_DNS=y
CONFIG_CMD_FS_UUID=y
CONFIG_CMD_LOG=y
# CONFIG_ISO_PARTITION is not set
CONFIG_ENV_OVERWRITE=y
CONFIG_VERSION_VARIABLE=y
CONFIG_BOOTP_SEND_HOSTNAME=y
CONFIG_IP_DEFRAG=y
# CONFIG_CLK is not set
# CONFIG_DM_I2C is not set
# CONFIG_SIFIVE_OTP is not set
# CONFIG_MMC_BROKEN_CD is not set
# CONFIG_MMC_SPI is not set
# CONFIG_MMC_QUIRKS is not set
# CONFIG_MMC_HW_PARTITIONING is not set
CONFIG_MMC_DW=y
# CONFIG_MTD is not set
CONFIG_SF_DEFAULT_MODE=0x0
CONFIG_SF_DEFAULT_SPEED=50000000
CONFIG_SPI_FLASH_BAR=y
CONFIG_SPI_FLASH_GIGADEVICE=y
# CONFIG_SPI_FLASH_ISSI is not set
CONFIG_PHY_ADDR_ENABLE=y
CONFIG_PHY_ADDR=7
CONFIG_PHY_MICREL=y
CONFIG_PHY_MICREL_KSZ90X1=y
# CONFIG_PHY_MSCC is not set
# CONFIG_DM_ETH is not set
CONFIG_ETH_DESIGNWARE=y
CONFIG_RGMII=y
# CONFIG_MII is not set
# CONFIG_DM_PWM is not set
# CONFIG_RAM_SIFIVE is not set
CONFIG_SPECIFY_CONSOLE_INDEX=y
# CONFIG_SIFIVE_SERIAL is not set
CONFIG_CADENCE_QSPI=y
# CONFIG_SPI_SIFIVE is not set
# CONFIG_SYSRESET is not set
# CONFIG_FAT_WRITE is not set
# CONFIG_ASYMMETRIC_KEY_TYPE is not set
# CONFIG_GENERATE_SMBIOS_TABLE is not set
# CONFIG_EFI_LOAD_FILE2_INITRD is not set
CONFIG_UNIT_TEST=y
```
