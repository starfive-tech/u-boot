## configs/starfive_jh7100_visionfive_smode_defconfig
```kconfig
CONFIG_RISCV=y
CONFIG_SYS_MALLOC_LEN=0x800000
CONFIG_SYS_MALLOC_F_LEN=0x3000
CONFIG_NR_DRAM_BANKS=1
CONFIG_SYS_MEMTEST_START=0x80000000
CONFIG_SYS_MEMTEST_END=0x200000000
CONFIG_ENV_SIZE=0x1f000
CONFIG_ENV_SECT_SIZE=0x1000
# CONFIG_DM_GPIO is not set
CONFIG_DEFAULT_DEVICE_TREE="jh7100-visionfive"
CONFIG_IDENT_STRING="StarFive"
CONFIG_SYS_CLK_FREQ=1000000000
CONFIG_TARGET_STARFIVE_JH7100=y
CONFIG_JH_STARLIGHT=y
CONFIG_ARCH_RV64I=y
CONFIG_RISCV_SMODE=y
CONFIG_SHOW_REGS=y
CONFIG_LOCALVERSION="-VisionFive"
CONFIG_DISTRO_DEFAULTS=y
CONFIG_SYS_BOOT_GET_CMDLINE=y
CONFIG_SYS_BOOT_GET_KBD=y
CONFIG_SYS_LOAD_ADDR=0x80200000
CONFIG_FIT=y
CONFIG_CHROMEOS=y
CONFIG_SHOW_BOOT_PROGRESS=y
CONFIG_QSPI_BOOT=y
CONFIG_SD_BOOT=y
CONFIG_SPI_BOOT=y
CONFIG_AUTOBOOT_KEYED=y
CONFIG_AUTOBOOT_DELAY_STR="f"
CONFIG_AUTOBOOT_STOP_STR="v"
CONFIG_AUTOBOOT_KEYED_CTRLC=y
# CONFIG_USE_BOOTCOMMAND is not set
CONFIG_USE_PREBOOT=y
CONFIG_PREBOOT="run mmcbootenv"
CONFIG_DEFAULT_FDT_FILE="starfive/jh7100-visionfive.dtb"
CONFIG_CONSOLE_RECORD=y
CONFIG_LOG_MAX_LEVEL=5
CONFIG_LOG_ERROR_RETURN=y
CONFIG_DISPLAY_CPUINFO=y
CONFIG_DISPLAY_BOARDINFO=y
CONFIG_MISC_INIT_R=y
CONFIG_ID_EEPROM=y
CONFIG_SYS_PROMPT="VisionFive #"
CONFIG_CMD_CONFIG=y
CONFIG_CMD_LICENSE=y
CONFIG_CMD_SBI=y
CONFIG_CMD_BOOTZ=y
CONFIG_BOOTM_OPENRTOS=y
CONFIG_CMD_BOOTEFI_SELFTEST=y
CONFIG_CMD_IMLS=y
CONFIG_CMD_ASKENV=y
CONFIG_CMD_GREPENV=y
CONFIG_CMD_ERASEENV=y
CONFIG_CMD_ENV_CALLBACK=y
CONFIG_CMD_ENV_FLAGS=y
CONFIG_CMD_NVEDIT_EFI=y
CONFIG_CMD_NVEDIT_INFO=y
CONFIG_CMD_NVEDIT_LOAD=y
CONFIG_CMD_NVEDIT_SELECT=y
CONFIG_CMD_BINOP=y
CONFIG_CRC32_VERIFY=y
CONFIG_CMD_EEPROM=y
CONFIG_SYS_EEPROM_SIZE=512
CONFIG_SYS_EEPROM_PAGE_WRITE_BITS=4
CONFIG_SYS_EEPROM_PAGE_WRITE_DELAY_MS=5
CONFIG_LOOPW=y
CONFIG_CMD_MD5SUM=y
CONFIG_MD5SUM_VERIFY=y
CONFIG_CMD_MEMINFO=y
CONFIG_CMD_MEM_SEARCH=y
CONFIG_CMD_MX_CYCLIC=y
CONFIG_CMD_MEMTEST=y
CONFIG_SYS_ALT_MEMTEST=y
CONFIG_CMD_SHA1SUM=y
CONFIG_SHA1SUM_VERIFY=y
CONFIG_CMD_STRINGS=y
CONFIG_CMD_CLK=y
# CONFIG_CMD_GPIO is not set
CONFIG_CMD_GPT_RENAME=y
CONFIG_CMD_I2C=y
CONFIG_CMD_LSBLK=y
CONFIG_CMD_MBR=y
CONFIG_CMD_MISC=y
CONFIG_CMD_BKOPS_ENABLE=y
CONFIG_CMD_MMC_SWRITE=y
CONFIG_CMD_CLONE=y
CONFIG_CMD_READ=y
CONFIG_CMD_SF_TEST=y
CONFIG_CMD_SETEXPR_FMT=y
CONFIG_BOOTP_DNS2=y
CONFIG_BOOTP_PREFER_SERVERIP=y
CONFIG_BOOTP_NTPSERVER=y
CONFIG_CMD_TFTPPUT=y
CONFIG_CMD_RARP=y
# CONFIG_CMD_MII is not set
CONFIG_CMD_MDIO=y
CONFIG_CMD_DNS=y
CONFIG_CMD_TIMER=y
CONFIG_CMD_UUID=y
CONFIG_CMD_AES=y
CONFIG_CMD_HASH=y
CONFIG_HASH_VERIFY=y
CONFIG_CMD_CBFS=y
CONFIG_CMD_CRAMFS=y
CONFIG_CMD_EXT4_WRITE=y
CONFIG_CMD_SQUASHFS=y
CONFIG_CMD_FS_UUID=y
CONFIG_CMD_DIAG=y
CONFIG_CMD_LOG=y
CONFIG_ENV_OVERWRITE=y
CONFIG_ENV_IS_IN_SPI_FLASH=y
CONFIG_ENV_SECT_SIZE_AUTO=y
CONFIG_ENV_VARS_UBOOT_RUNTIME_CONFIG=y
CONFIG_VERSION_VARIABLE=y
CONFIG_BOOTP_SEND_HOSTNAME=y
CONFIG_NET_RANDOM_ETHADDR=y
CONFIG_NETCONSOLE=y
CONFIG_IP_DEFRAG=y
CONFIG_TFTP_TSIZE=y
CONFIG_SERVERIP_FROM_PROXYDHCP=y
CONFIG_SIFIVE_CCACHE_WAYENABLE_OPT=y
CONFIG_SIFIVE_CCACHE_WAYENABLE_NUM=16
# CONFIG_CLK is not set
CONFIG_SYS_I2C_DW=y
# CONFIG_SYS_I2C_OCORES is not set
# CONFIG_SIFIVE_OTP is not set
CONFIG_I2C_EEPROM=y
CONFIG_SYS_I2C_EEPROM_ADDR=0x50
# CONFIG_MMC_BROKEN_CD is not set
# CONFIG_MMC_SPI is not set
# CONFIG_MMC_QUIRKS is not set
# CONFIG_MMC_HW_PARTITIONING is not set
CONFIG_MMC_DW=y
# CONFIG_MTD is not set
CONFIG_SF_DEFAULT_SPEED=50000000
CONFIG_SPI_FLASH_BAR=y
CONFIG_SPI_FLASH_GIGADEVICE=y
# CONFIG_SPI_FLASH_ISSI is not set
CONFIG_MTD_UBI=y
CONFIG_PHY_ADDR_ENABLE=y
CONFIG_PHY_ADDR=3
# CONFIG_PHY_MSCC is not set
CONFIG_PHY_YUTAI=y
# CONFIG_DM_ETH is not set
CONFIG_ETH_DESIGNWARE=y
CONFIG_RGMII=y
# CONFIG_MII is not set
# CONFIG_DM_PWM is not set
# CONFIG_RAM_SIFIVE is not set
CONFIG_SPECIFY_CONSOLE_INDEX=y
# CONFIG_SIFIVE_SERIAL is not set
CONFIG_CADENCE_QSPI=y
# CONFIG_SPI_SIFIVE is not set
# CONFIG_SYSRESET is not set
CONFIG_FS_CBFS=y
# CONFIG_FAT_WRITE is not set
CONFIG_FS_CRAMFS=y
# CONFIG_ASYMMETRIC_KEY_TYPE is not set
CONFIG_ERRNO_STR=y
# CONFIG_GENERATE_SMBIOS_TABLE is not set
CONFIG_UNIT_TEST=y
```

## drivers/cache/Kconfig
```kconfig
#
# Cache controllers
#

menu "Cache Controller drivers"

config CACHE
	bool "Enable Driver Model for Cache controllers"
	depends on DM
	help
	  Enable driver model for cache controllers that are found on
	  most CPU's. Cache is memory that the CPU can access directly and
	  is usually located on the same chip. This uclass can be used for
	  configuring settings that be found from a device tree file.

config L2X0_CACHE
	tristate "PL310 cache driver"
	select CACHE
	depends on ARM
	help
	  This driver is for the PL310 cache controller commonly found on
	  ARMv7(32-bit) devices. The driver configures the cache settings
	  found in the device tree.

config V5L2_CACHE
	bool "Andes V5L2 cache driver"
	select CACHE
	depends on RISCV_NDS_CACHE
	help
	  Support Andes V5L2 cache controller in AE350 platform.
	  It will configure tag and data ram timing control from the
	  device tree and enable L2 cache.

config NCORE_CACHE
	bool "Arteris Ncore cache coherent unit driver"
	select CACHE
	help
	  This driver is for the Arteris Ncore cache coherent unit (CCU)
	  controller. The driver initializes cache directories and coherent
	  agent interfaces.

config SIFIVE_CCACHE
	bool "SiFive composable cache"
	select CACHE
	help
	  This driver is for SiFive Composable L2/L3 cache. It enables cache
	  ways of composable cache.

config SIFIVE_CCACHE_WAYENABLE_OPT
	bool "SiFive composable cache: customized the largest way enabled."
	depends on SIFIVE_CCACHE

config SIFIVE_CCACHE_WAYENABLE_NUM
	int "SiFive composable cache: the largest way which will be enabled"
	depends on SIFIVE_CCACHE_WAYENABLE_OPT
	default 1
	range 1 256
	help
	  Range[1, 256]. The index of the largest way which will be enabled.

endmenu
```

## drivers/net/Kconfig.dw
```kconfig
config ETH_DESIGNWARE_PRESETED_BUFF
	depends on ETH_DESIGNWARE
	bool "Preseted mem for Synopsys Designware Ethernet MAC"
	default y if TARGET_STARFIVE_JH7100

if ETH_DESIGNWARE_PRESETED_BUFF

config ETH_DESIGNWARE_PRESETED_TX_MAC_DES_BASE
	hex "Preseted mem for preseted_tx_mac_descrtable"
	default 0x18001000

config ETH_DESIGNWARE_PRESETED_RX_MAC_DES_BASE
	hex "Preseted mem for preseted_rx_mac_descrtable"
	default 0x18002000

config ETH_DESIGNWARE_PRESETED_TXBUFF_BASE
	hex "Preseted mem for preseted_txbuffs"
	default 0x18010000

config ETH_DESIGNWARE_PRESETED_RXBUFF_BASE
	hex "Preseted mem for preseted_rxbuffs"
	default 0x18018000

endif #ETH_DESIGNWARE_PRESETED_BUFF
```

## drivers/ram/starfive/Kconfig
```kconfig
config SPL_STARFIVE_DDR
	bool "StarFive DDR driver in SPL"
	depends on SPL_RAM && STARFIVE_JH7110
	help
	  This enables DDR support for the platforms based on StarFive JH7110 SoC.

config RAM_STARFIVE
	bool "Ram drivers support for StarFive SoCs"
	depends on RAM && RISCV
	default y
	help
	  This enables support for ram drivers of StarFive SoCs.

config STARFIVE_DUBHE_DDR
	bool "StarFive Dubhe DDR driver"
	depends on RAM_STARFIVE
	default y if TARGET_STARFIVE_DUBHE_FPGA
	help
	  This enables DDR4/LPDDR4 support for the platforms based on StarFive Dubhe.
```
