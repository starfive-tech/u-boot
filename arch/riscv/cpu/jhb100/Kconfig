## arch/riscv/cpu/jhb100/Kconfig
```kconfig
# SPDX-License-Identifier: GPL-2.0+
#
# Copyright (c) 2021-2025 StarFive Technology Co., Ltd.

config STARFIVE_JHB100
	bool
	select SUPPORT_SPL
	select RAM
	select SPL_RAM if SPL
	select SYS_CACHE_SHIFT_6
	imply CPU
	imply CPU_RISCV
	imply RISCV_TIMER if (RISCV_SMODE || SPL_RISCV_SMODE)
	imply SPL_RISCV_ACLINT
	imply CMD_CPU
	imply SPL_CPU
	imply SPL_OPENSBI
	imply SPL_LOAD_FIT
	imply SMP
	imply DM_SERIAL
	imply ZYNQ_SERIAL
	imply MII
	imply MMC
	imply MMC_SPI
	imply MMC_BROKEN_CD
	imply CMD_MMC
	imply DM_GPIO
	imply STARFIVE_GPIO
	imply CMD_GPIO
	imply MISC
	imply STARFIVE_OTP
	imply DM_PWM
	imply PWM_SIFIVE
	imply DM_I2C
	imply SYS_I2C_OCORES

if ENV_IS_IN_SPI_FLASH

config ENV_OFFSET
	default 0x505000

config ENV_SIZE
	default 0x20000

config ENV_SECT_SIZE
	default 0x10000

endif # ENV_IS_IN_SPI_FLASH

config STARFIVE_JHB100_FIT_VERIFICATION
	bool "Enable FIT verification with Starfive JHB100"
	depends on TARGET_STARFIVE_JHB100
	select FIT_IMAGE_POST_PROCESS
	select SPL_FIT_IMAGE_POST_PROCESS
	help
	  All images loaded from FIT will be verified

config STARFIVE_SECURE_SERVICES_TOOL
	bool "StarFive Secure Services Tool"
	depends on TARGET_STARFIVE_JHB100
	select SPL_DRIVERS_MISC
	select SPL_DM_MAILBOX
	select SPL_DM_RPMI_SRV_GRP
	select RPMI_SHMEM_MBOX
	select RPMI_STARFIVE_SEC_SERVICE_RUNTIME_GRP
	select CMD_STARFIVE_SEC
	select SPL_CMD_STARFIVE_SEC
	select CMD_STARFIVE
	select STARFIVE_JHB100_MPXY_SEC
	help
	  This is a configuration to enable StarFive Secure Service Tools

config SPL_FS_LOAD_RECOVERY_PAYLOAD_NAME
	string "MMC recovery image for u-boot.itb"
	depends on TARGET_STARFIVE_JHB100
	default "u-boot-recovery.itb"
	help
	  This is a customised string configuration for StarFive JHB100

config STARFIVE_JHB100_MPXY_SEC
	bool "StarFive JHB100 MPXY Sec IOCTL driver"
	depends on TARGET_STARFIVE_JHB100 && RISCV_SMODE
	select MISC
    select SBI_MPXY
	help
	  Enable support for MPXY Secure Runtime Services to communicate with
	  L1 Firmware of the SoC. This driver allows one to request for secure
	  services required to perform authentications and firmware updates.

config JHB100_ENABLE_LOAD_TEMP_IMG_FOR_EMMC
	bool "Load EMMC Temp image from GPP partition"
	depends on TARGET_STARFIVE_JHB100
	help
	 Enable loading of Temp image from GPP

config JHB100_UPD_RCV_TEST_TRACE
	bool "Starfive JHB100 Update and Recovery Test Trace"
	depends on TARGET_STARFIVE_JHB100
	help
	 Enable update and recovery test trace

config RANDOMIZED_TEST_PATTERN
	bool "Update and Recovery Test Pattern Randomizer"
	depends on TARGET_STARFIVE_JHB100
	help
	 Enable update and recovery test pattern randomizer

config STARFIVE_JHB100_WDT_ADV_CFG
	bool "Advanced configuration of Starfive JHB100 WDT operation mode"
	depends on TARGET_STARFIVE_JHB100
	help
	 Enable configuration such as operating in two stage timeout or pulse mode

config STARFIVE_JHB100_QUERY_DDR_INFO
	bool "Query DDR info (size) from SCP and update device tree"
	depends on TARGET_STARFIVE_JHB100
	help
	 Enable runtime modification of U-boot and Linux device tree memory node

choice
	prompt "StarFive JHB100 SFC partition mechanism"
	depends on TARGET_STARFIVE_JHB100

config STARFIVE_JHB100_SFC_NONE
	bool "None selected (build error)"
	help
	 Placeholder so an unset choice does not silently fall back to
	 AGT or AB. Selecting this (or leaving a defconfig without an
	 explicit choice) fails the build with a clear error instead.

config STARFIVE_JHB100_SFC_AGT
	bool "AGT (active/golden/temp) partition layout"
	help
	 StarFive JHB100 SFC boot flow using AGT partitions.

config STARFIVE_JHB100_SFC_AB
	bool "AB (active/backup) partition layout"
	help
	 StarFive JHB100 SFC boot flow using AB partitions.

endchoice
```

## board/starfive/jhb100/Kconfig
```kconfig
if TARGET_STARFIVE_JHB100

config SYS_CPU
	default "jhb100"

config SYS_BOARD
	default "jhb100"

config SYS_VENDOR
	default "starfive"

config SYS_SOC
	default "jhb100"

config SYS_CONFIG_NAME
	default "starfive-jhb100"

config ENV_SIZE
	default 0x2000 if ENV_IS_IN_SPI_FLASH

config ENV_OFFSET
	default 0x140000 if ENV_IS_IN_SPI_FLASH

config TEXT_BASE
	default 0x40200000 if SPL
	default 0x40100000 if !RISCV_SMODE
	default 0x40200000 if RISCV_SMODE

config SPL_TEXT_BASE
	default 0x40000000

config SPL_OPENSBI_LOAD_ADDR
	default 0x40100000

config BOARD_SPECIFIC_OPTIONS # dummy
	def_bool y
	select STARFIVE_JHB100
#	select ENV_IS_IN_SPI_FLASH
	select BINMAN
	imply CMD_DHCP
	imply CMD_EXT2
	imply CMD_EXT4
	imply CMD_FAT
	imply CMD_FS_GENERIC
	imply CMD_GPT
	imply PARTITION_TYPE_GUID
	imply CMD_NET
	imply CMD_PING
#	imply CMD_SF
	imply DOS_PARTITION
	imply EFI_PARTITION
	imply IP_DYN
	imply ISO_PARTITION
	imply PHY_LIB
	imply PHY_MSCC
#	imply SPI_FLASH
#	imply SPI_FLASH_ISSI
	imply SYSRESET
	imply SYSRESET_GPIO

config STARFIVE_JHB100_ENV_CS_DYNAMIC
	bool "Dynamically detect the SPI flash chip-select for the environment"
	depends on ENV_IS_IN_SPI_FLASH
	default n
	help
	  On dual-flash (CS0/CS1) boards the active u-boot-proper image, and
	  therefore the environment, can live on either chip select. Enable
	  this to query the active chip select at runtime via
	  starfive_get_sfc_cs() instead of always using the compiled-in
	  CONFIG_ENV_SPI_CS.

config STARFIVE_JHB100_FDTMODIFY_DEFAULT
	bool "Enable device tree fixups by default (fdtmodify=yes)"
	depends on TARGET_STARFIVE_JHB100
	default n
	help
	 Set the compiled-in default of the "fdtmodify" environment variable
	 to "yes" instead of "no", so the SFC device tree fixups run in
	 ft_board_setup() without the user having to set the variable first.
	 The variable can still be flipped at runtime with
	 "setenv fdtmodify yes|no".

config STARFIVE_JHB100_SAFE_MTEST
	bool "Run safe memtest from board_late_init()"
	depends on CMD_MEMTEST
	default n
	help
	  Run a board-local memory test during board_late_init(). The test
	  dynamically computes testable ranges from the LMB memory map and
	  skips all reserved regions before writing test patterns.

endif
```

## cmd/starfive/Kconfig
```kconfig
menu "StarFive specific command line interface"

config CMD_STARFIVE
	bool "Enable StarFive command line interface in U-Boot"
	depends on TARGET_STARFIVE_JHB100
	help
	  Enable StarFive command line interface in U-Boot

config CMD_STARFIVE_SEC
	bool "command for Secure Services"
	depends on CMD_STARFIVE && CRC32
	help
	  Support for StarFive Secure Runtime Services. The SEC commands
	  available includes secure boot, firmware update, attestation and OTP read/
	  write.

config SPL_CMD_STARFIVE_SEC
	bool "command for Secure Services"
	depends on SPL && CMD_STARFIVE && CRC32
	help
	  Support for StarFive Secure Runtime Services. The SEC commands
	  available includes secure boot, firmware update, attestation and OTP read/write.

config CMD_STARFIVE_LTPI
	bool "command for LTPI"
	depends on CMD_STARFIVE
	help
	  Support for StarFive Diagnostic Services for LTPI.

config CMD_JHB100_DP
	bool "dp"
	depends on VIDEO && DISPLAY
	help
	  DisplayPort test command for the JHB100 DC8000 + DPTX pipeline.

config CMD_JHB100_NETTEST
	bool "nettest"
	depends on CMD_STARFIVE && NET
	help
	  JHB100 Ethernet test command.

endmenu
```

## configs/starfive_jhb100_defconfig
```kconfig
CONFIG_RISCV=y
CONFIG_SYS_MALLOC_F_LEN=0x10000
CONFIG_NR_DRAM_BANKS=1
CONFIG_HAS_CUSTOM_SYS_INIT_SP_ADDR=y
CONFIG_CUSTOM_SYS_INIT_SP_ADDR=0x40200000
CONFIG_SF_DEFAULT_SPEED=20000000
CONFIG_ENV_SIZE=0x10000
CONFIG_ENV_OFFSET=0x610000
CONFIG_SPL_DM_SPI=y
CONFIG_DEFAULT_DEVICE_TREE="jhb100-fpga"
CONFIG_DM_RESET=y
CONFIG_SPL_MMC=y
CONFIG_SPL_BSS_START_ADDR=0x40080000
CONFIG_SPL_BSS_MAX_SIZE=0x00010000
CONFIG_SPL=y
CONFIG_SYS_CLK_FREQ=1000000000
CONFIG_SPL_FS_FAT=y
CONFIG_SPL_SPI_FLASH_SUPPORT=y
CONFIG_SPL_SPI=y
CONFIG_SYS_LOAD_ADDR=0x81000000
CONFIG_PCI=y
CONFIG_TARGET_STARFIVE_JHB100=y
CONFIG_STARFIVE_JHB100_FIT_VERIFICATION=y
CONFIG_ARCH_RV64I=y
CONFIG_RISCV_SMODE=y
CONFIG_SHOW_REGS=y
CONFIG_STACK_SIZE=0x50000
CONFIG_FIT=y
CONFIG_SPL_LOAD_FIT_ADDRESS=0x50000000
CONFIG_SYS_BOOTM_LEN=0x2000000
CONFIG_SUPPORT_RAW_INITRD=y
CONFIG_USE_BOOTARGS=y
CONFIG_BOOTARGS="console=ttyS0,115200 debug rootwait earlycon=sbi root=/dev/ram0 rw"
CONFIG_USE_BOOTCOMMAND=y
CONFIG_DISPLAY_CPUINFO=y
CONFIG_DISPLAY_BOARDINFO=y
CONFIG_DISPLAY_BOARDINFO_LATE=y
CONFIG_BOARD_LATE_INIT=y
CONFIG_SPL_MAX_SIZE=0x00060000
CONFIG_SPL_SYS_MALLOC=y
CONFIG_SPL_HAS_CUSTOM_MALLOC_START=y
CONFIG_SPL_CUSTOM_SYS_MALLOC_ADDR=0x44000000
CONFIG_SPL_SYS_MALLOC_SIZE=0x00800000
CONFIG_SPL_ENV_SUPPORT=y
CONFIG_SPL_ETH=y
CONFIG_SPL_FS_EXT4=y
CONFIG_SPL_DM_SPI_FLASH=y
CONFIG_SPL_NET=y
CONFIG_SPL_NET_VCI_STRING="U-Boot"
CONFIG_SPL_DM_RESET=y
CONFIG_SPL_RAM_SUPPORT=y
CONFIG_SPL_RAM_DEVICE=y
# CONFIG_SPL_SPI_FLASH_TINY is not set
CONFIG_SPL_SPI_LOAD=y
CONFIG_SPL_WATCHDOG=y
CONFIG_SPL_YMODEM_SUPPORT=y
CONFIG_HUSH_PARSER=y
CONFIG_SYS_PROMPT="StarFive # "
CONFIG_CRC32_VERIFY=y
CONFIG_CMD_PWM=y
CONFIG_CMD_I2C=y
CONFIG_CMD_LOADXY_TIMEOUT=0
CONFIG_CMD_MISC=y
CONFIG_CMD_MTD=y
CONFIG_CMD_PART=y
CONFIG_CMD_PCI=y
CONFIG_CMD_SF_TEST=y
CONFIG_CMD_SPI=y
CONFIG_CMD_WDT=y
CONFIG_CMD_TFTPPUT=y
CONFIG_CMD_WGET=y
CONFIG_CMD_MII=y
CONFIG_CMD_TIMER=y
CONFIG_CMD_MTDPARTS=y
CONFIG_MMC_SPEED_MODE_SET=y
CONFIG_OF_LIVE=y
CONFIG_ENV_IS_IN_FAT=y
CONFIG_ENV_IS_IN_MMC=y
CONFIG_ENV_IS_IN_SPI_FLASH=y
CONFIG_ENV_FAT_DEVICE_AND_PART=":1"
CONFIG_NET_RANDOM_ETHADDR=y
CONFIG_PROT_TCP_SACK=y
CONFIG_REGMAP=y
CONFIG_SYSCON=y
CONFIG_SPL_CLK=y
CONFIG_CLK_STARFIVE_JHB100_SYS=y
CONFIG_CLK_STARFIVE_JHB100_PER0=y
CONFIG_CLK_STARFIVE_JHB100_PER1=y
CONFIG_CLK_STARFIVE_JHB100_PER2=y
CONFIG_CLK_STARFIVE_JHB100_PER3=y
CONFIG_DM_HWSPINLOCK=y
CONFIG_HWSPINLOCK_STARFIVE_JHB100=y
CONFIG_SYS_I2C_DW=y
CONFIG_SYS_I2C_DWC=y
CONFIG_SYS_MMC_MAX_BLK_COUNT=8192
CONFIG_SUPPORT_EMMC_RPMB=y
CONFIG_MMC_SDHCI=y
CONFIG_MMC_SDHCI_ADMA=y
CONFIG_SPL_MMC_SDHCI_ADMA=y
CONFIG_MMC_SDHCI_ROCKCHIP=y
CONFIG_DM_MTD=y
CONFIG_SF_DEFAULT_BUS=1
CONFIG_SPI_FLASH_GIGADEVICE=y
CONFIG_SPI_FLASH_ISSI=y
CONFIG_SPI_FLASH_MACRONIX=y
CONFIG_SPI_FLASH_SPANSION=y
CONFIG_SPI_FLASH_STMICRO=y
CONFIG_SPI_FLASH_WINBOND=y
CONFIG_SPI_FLASH_MTD=y
CONFIG_PHY_MARVELL=y
CONFIG_PHY_ETHERNET_ID=y
CONFIG_DM_ETH_PHY=y
CONFIG_DWC_ETH_QOS=y
CONFIG_DWC_ETH_QOS_STARFIVE=y
CONFIG_RGMII=y
CONFIG_NVME_PCI=y
CONFIG_PHY=y
CONFIG_PINCTRL=y
CONFIG_PINCONF=y
CONFIG_PINCTRL_STARFIVE_JHB100=y
CONFIG_PWM_STARFIVE=y
CONFIG_RESET_STARFIVE=y
CONFIG_RESET_STARFIVE_JHB100=y
CONFIG_SERIAL_RX_BUFFER=y
CONFIG_SYS_NS16550=y
CONFIG_SYS_NS16550_MEM32=y
CONFIG_SPI=y
CONFIG_DESIGNWARE_SPI=y
CONFIG_STARFIVE_DUAL_TIMER=y
CONFIG_WDT=y
CONFIG_WDT_STARFIVE_JHB100=y
```

## configs/starfive_jhb100_min_defconfig
```kconfig
CONFIG_RISCV=y
CONFIG_SYS_MALLOC_F_LEN=0x20000
CONFIG_SPL_GPIO=y
CONFIG_NR_DRAM_BANKS=1
CONFIG_HAS_CUSTOM_SYS_INIT_SP_ADDR=y
CONFIG_CUSTOM_SYS_INIT_SP_ADDR=0x40200000
CONFIG_SF_DEFAULT_SPEED=20000000
CONFIG_ENV_SIZE=0x10000
CONFIG_ENV_OFFSET=0x400000
CONFIG_SPL_DM_SPI=y
CONFIG_DEFAULT_DEVICE_TREE="jhb100-evb1-eth"
CONFIG_DM_RESET=y
CONFIG_SPL_BSS_START_ADDR=0x40080000
CONFIG_SPL_BSS_MAX_SIZE=0x00010000
CONFIG_SPL=y
CONFIG_SYS_CLK_FREQ=1000000000
CONFIG_SPL_SPI_FLASH_SUPPORT=y
CONFIG_SPL_SPI=y
CONFIG_SYS_LOAD_ADDR=0x64000000
CONFIG_TARGET_STARFIVE_JHB100=y
CONFIG_STARFIVE_JHB100_FIT_VERIFICATION=y
CONFIG_STARFIVE_SECURE_SERVICES_TOOL=y
CONFIG_ARCH_RV64I=y
CONFIG_RISCV_SMODE=y
CONFIG_SHOW_REGS=y
CONFIG_STACK_SIZE=0x50000
CONFIG_FIT=y
CONFIG_SPL_LOAD_FIT_ADDRESS=0x47bb0000
# CONFIG_PXE_UTILS is not set
# CONFIG_BOOTSTD is not set
# CONFIG_BOOTMETH_EXTLINUX is not set
# CONFIG_BOOTMETH_VBE is not set
CONFIG_SYS_BOOTM_LEN=0x2000000
CONFIG_SUPPORT_RAW_INITRD=y
CONFIG_SHOW_BOOT_PROGRESS=y
CONFIG_SPL_SHOW_BOOT_PROGRESS=y
CONFIG_BOOTDELAY=5
CONFIG_AUTOBOOT_KEYED=y
CONFIG_AUTOBOOT_PROMPT="Hit SPACE to abort autoboot in %d seconds\n"
CONFIG_AUTOBOOT_STOP_STR=" "
CONFIG_OF_BOARD_SETUP=y
CONFIG_USE_BOOTARGS=y
CONFIG_BOOTARGS="rootwait earlycon=sbi root=/dev/ram0 rw pd_ignore_unused=1 clk_ignore_unused=1"
CONFIG_USE_BOOTCOMMAND=y
CONFIG_BOOTCOMMAND="run kernel_autoboot"
CONFIG_DISPLAY_CPUINFO=y
CONFIG_DISPLAY_BOARDINFO=y
CONFIG_DISPLAY_BOARDINFO_LATE=y
CONFIG_BOARD_LATE_INIT=y
CONFIG_SPL_MAX_SIZE=0x00060000
# CONFIG_SPL_RAW_IMAGE_SUPPORT is not set
CONFIG_SPL_SYS_MALLOC=y
CONFIG_SPL_HAS_CUSTOM_MALLOC_START=y
CONFIG_SPL_CUSTOM_SYS_MALLOC_ADDR=0x46000000
CONFIG_SPL_SYS_MALLOC_SIZE=0x00400000
CONFIG_SPL_ENV_SUPPORT=y
CONFIG_SPL_DM_SPI_FLASH=y
CONFIG_SPL_DM_RESET=y
CONFIG_SPL_RAM_SUPPORT=y
CONFIG_SPL_RAM_DEVICE=y
# CONFIG_SPL_SPI_FLASH_TINY is not set
CONFIG_SPL_SPI_LOAD=y
CONFIG_SPL_WATCHDOG=y
CONFIG_SPL_YMODEM_SUPPORT=y
CONFIG_HUSH_PARSER=y
CONFIG_SYS_PROMPT="StarFive # "
# CONFIG_MENU is not set
# CONFIG_BOOTM_NETBSD is not set
# CONFIG_BOOTM_PLAN9 is not set
# CONFIG_BOOTM_RTEMS is not set
# CONFIG_BOOTM_VXWORKS is not set
# CONFIG_CMD_BOOTFLOW is not set
# CONFIG_CMD_ELF is not set
CONFIG_CRC32_VERIFY=y
# CONFIG_CMD_LZMADEC is not set
# CONFIG_CMD_UNLZ4 is not set
CONFIG_CMD_MEMTEST=y
CONFIG_CMD_CLK=y
CONFIG_CMD_PWM=y
# CONFIG_CMD_GPT is not set
CONFIG_CMD_LOADXY_TIMEOUT=0
CONFIG_CMD_MISC=y
CONFIG_CMD_SF_TEST=y
CONFIG_CMD_SPI=y
CONFIG_DEFAULT_SPI_BUS=2
CONFIG_CMD_WDT=y
CONFIG_CMD_TFTPPUT=y
# CONFIG_CMD_LED is not set
CONFIG_CMD_TIMER=y
# CONFIG_CMD_EXT2 is not set
# CONFIG_CMD_EXT4 is not set
# CONFIG_CMD_FAT is not set
# CONFIG_DOS_PARTITION is not set
# CONFIG_ISO_PARTITION is not set
# CONFIG_EFI_PARTITION is not set
CONFIG_OF_LIVE=y
CONFIG_ENV_IS_IN_SPI_FLASH=y
CONFIG_NET_RANDOM_ETHADDR=y
CONFIG_SPL_DM_SEQ_ALIAS=y
CONFIG_REGMAP=y
CONFIG_SYSCON=y
CONFIG_SPL_CLK=y
CONFIG_CLK_STARFIVE_JHB100_SYS=y
CONFIG_CLK_STARFIVE_JHB100_PER0=y
CONFIG_CLK_STARFIVE_JHB100_PER1=y
CONFIG_CLK_STARFIVE_JHB100_PER2=y
CONFIG_CLK_STARFIVE_JHB100_PER3=y
CONFIG_CLK_STARFIVE_JHB100_CPU=y
CONFIG_GPIO_HOG=y
# CONFIG_I2C is not set
CONFIG_LED=y
CONFIG_LED_STARFIVE=y
CONFIG_SPL_LED=y
CONFIG_STARFIVE_IODOMAIN=y
CONFIG_SPL_STARFIVE_IODOMAIN=y
# CONFIG_MMC is not set
CONFIG_SPI_FLASH_SFDP_SUPPORT=y
CONFIG_SPI_FLASH_GIGADEVICE=y
CONFIG_SPI_FLASH_ISSI=y
CONFIG_SPI_FLASH_MACRONIX=y
CONFIG_SPI_FLASH_STMICRO=y
CONFIG_SPI_FLASH_WINBOND=y
CONFIG_PHY_REALTEK=y
CONFIG_PHY_ETHERNET_ID=y
CONFIG_DM_ETH_PHY=y
CONFIG_DWC_ETH_QOS=y
CONFIG_DWC_ETH_QOS_STARFIVE=y
CONFIG_RGMII=y
CONFIG_PHY=y
CONFIG_PHY_STARFIVE_INNO_ETH=y
CONFIG_PINCTRL=y
CONFIG_PINCONF=y
CONFIG_SPL_PINCTRL=y
CONFIG_SPL_PINCONF=y
CONFIG_PINCTRL_STARFIVE_JHB100=y
CONFIG_RESET_STARFIVE=y
CONFIG_RESET_STARFIVE_JHB100=y
CONFIG_SERIAL_RX_BUFFER=y
CONFIG_SYS_NS16550=y
CONFIG_SYS_NS16550_MEM32=y
CONFIG_SPI=y
CONFIG_DESIGNWARE_SPI=y
CONFIG_STARFIVE_DUAL_TIMER=y
CONFIG_WDT=y
CONFIG_WDT_STARFIVE_JHB100=y
# CONFIG_EFI_LOADER is not set
CONFIG_LMB_MAX_REGIONS=32
```
