## configs/starfive_jhb100_secure_defconfig
```kconfig
CONFIG_RISCV=y
CONFIG_TEXT_BASE=0x40100000
CONFIG_SYS_MALLOC_F_LEN=0x3000
CONFIG_NR_DRAM_BANKS=1
CONFIG_HAS_CUSTOM_SYS_INIT_SP_ADDR=y
CONFIG_CUSTOM_SYS_INIT_SP_ADDR=0x40200000
CONFIG_SF_DEFAULT_SPEED=20000000
CONFIG_SPL_DM_SPI=y
CONFIG_SPL_DM_SPI_FLASH=y
CONFIG_DEFAULT_DEVICE_TREE="jhb100-fpga"
CONFIG_SPL=y
CONFIG_SPL_SEPARATE_BSS=y
CONFIG_SPL_OPENSBI_LOAD_ADDR=0x40000000
CONFIG_SPL_SPI_FLASH_SUPPORT=y
CONFIG_SPL_SPI=y
CONFIG_SYS_LOAD_ADDR=0x81000000
CONFIG_TARGET_STARFIVE_JHB100=y
CONFIG_ARCH_RV64I=y
CONFIG_RISCV_SMODE=y
CONFIG_FIT=y
CONFIG_SPL_LOAD_FIT_ADDRESS=0x50000000
CONFIG_SYS_BOOTM_LEN=0x2000000
CONFIG_SUPPORT_RAW_INITRD=y
CONFIG_USE_BOOTARGS=y
CONFIG_USE_BOOTCOMMAND=y
CONFIG_LOG_MAX_LEVEL=4
CONFIG_SPL_LOG=y
CONFIG_DISPLAY_CPUINFO=y
CONFIG_DISPLAY_BOARDINFO=y
CONFIG_DISPLAY_BOARDINFO_LATE=y
CONFIG_SPL_MAX_SIZE=0x00060000
CONFIG_SPL_BSS_START_ADDR=0x40080000
CONFIG_SPL_BSS_MAX_SIZE=0x00010000
CONFIG_SPL_SYS_MALLOC=y
CONFIG_SPL_HAS_CUSTOM_MALLOC_START=y
CONFIG_SPL_CUSTOM_SYS_MALLOC_ADDR=0x44000000
CONFIG_SPL_SYS_MALLOC_SIZE=0x00800000
CONFIG_SPL_ENV_SUPPORT=y
CONFIG_SPL_ETH=y
CONFIG_SPL_FS_EXT4=y
CONFIG_SYS_MMCSD_FS_BOOT_PARTITION=2
CONFIG_SPL_DM_SPI_FLASH=y
CONFIG_SPL_NET=y
CONFIG_SPL_NET_VCI_STRING="U-Boot"
CONFIG_SPL_DM_RESET=y
CONFIG_SPL_RAM_SUPPORT=y
CONFIG_SPL_RAM_DEVICE=y
CONFIG_RAM=y
CONFIG_SPL_RAM=y
CONFIG_SPL_YMODEM_SUPPORT=y
CONFIG_SPL_LOAD_FIT_ADDRESS=0xa0000000
CONFIG_SYS_LOAD_ADDR=0x81000000
CONFIG_SPL_LOAD_FIT=y
CONFIG_STARFIVE_JHB100=y
CONFIG_STARFIVE_JHB100_L2CC_FLUSH=y
CONFIG_STARFIVE_JHB100_L2CC_FLUSH_START=0x80000000
CONFIG_STARFIVE_JHB100_L2CC_FLUSH_SIZE=0x800000000
CONFIG_SUPPORT_RAW_INITRD=y
CONFIG_SERIAL_RX_BUFFER=y
CONFIG_SERIAL_RX_BUFFER_SIZE=256
CONFIG_STACK_SIZE=0x50000
CONFIG_NR_CPUS=8
CONFIG_CMD_I2C=y
CONFIG_DM_PWM=y
CONFIG_CMD_PWM=y
CONFIG_PWM_STARFIVE=y
CONFIG_SPL_REGMAP=y
CONFIG_SPL_SYSCON=y
CONFIG_SPL_DM_RESET=y
CONFIG_RESET_STARFIVE=y
CONFIG_RESET_STARFIVE_JHB100=y
CONFIG_REGMAP=y
CONFIG_SYSCON=y
CONFIG_CMD_TIMER=y
CONFIG_TIMER=y
CONFIG_STARFIVE_TIMER=y
CONFIG_WDT=y
CONFIG_CMD_WDT=y
CONFIG_SPL_WATCHDOG=y
CONFIG_WDT_STARFIVE=y
CONFIG_SPL_BSS_START_ADDR=0xb035000
CONFIG_SPL_BSS_MAX_SIZE=0x00004000
CONFIG_HAS_CUSTOM_SYS_INIT_SP_ADDR=y
CONFIG_CUSTOM_SYS_INIT_SP_ADDR=0x40200000
CONFIG_SYS_SPL_MALLOC=y
CONFIG_HAS_CUSTOM_SPL_MALLOC_START=y
CONFIG_CUSTOM_SYS_SPL_MALLOC_ADDR=0x80000000
CONFIG_SYS_BOOTM_LEN=0x2000000
CONFIG_SYS_CLK_FREQ=1000000000
CONFIG_SYS_SPL_MALLOC_SIZE=0x00100000
CONFIG_SPL_MAX_SIZE=0x00035000
CONFIG_BOOTARGS="console=ttyPS,115200 debug rootwait earlycon=cdns root=/dev/ram0 rw"
CONFIG_BOOTCOMMAND=""
CONFIG_PINCTRL=y
CONFIG_PINCONF=y
CONFIG_PINCTRL_STARFIVE_JHB100=y
CONFIG_SPL_ENV_SUPPORT=y
CONFIG_SPL_ETH=y
CONFIG_DM_ETH=y
CONFIG_DM_ETH_PHY=y
CONFIG_SPL_NET_SUPPORT=y
CONFIG_CMD_NET=y
CONFIG_SPL_NET_VCI_STRING="U-Boot"
CONFIG_SPL_STARFIVE_ETH=y
CONFIG_PHY_MARVELL=y
CONFIG_RGMII=y
CONFIG_CMD_MII=y
CONFIG_CMD_MDIO=y
CONFIG_NETDEVICES=y
CONFIG_GZIP=y
CONFIG_MMC_SDHCI=y
CONFIG_MMC_SDHCI_CADENCE=y
CONFIG_MMC_SDHCI_CADENCE_V6=y
CONFIG_MMC_HS200_SUPPORT=y
CONFIG_MMC_HS400_SUPPORT=y
CONFIG_MMC_HS400_ES_SUPPORT=y
CONFIG_MMC_SPEED_MODE_SET=y
CONFIG_CMD_EXT4=y
CONFIG_CMD_EXT4_WRITE=y
CONFIG_MMC_SDHCI_ADMA=y
CONFIG_CADENCE_XSPI=y
CONFIG_CMD_MTD=y
CONFIG_CMD_MTDPARTS=y
CONFIG_DM_MTD=y
CONFIG_SF_DEFAULT_SPEED=20000000
CONFIG_SPI_FLASH_GIGADEVICE=y
CONFIG_SPI_FLASH_ISSI=y
CONFIG_SPI_FLASH_MACRONIX=y
CONFIG_SPI_FLASH_SPANSION=y
CONFIG_SPI_FLASH_STMICRO=y
CONFIG_SPI_FLASH_WINBOND=y
CONFIG_SPI_FLASH_MTD=y
CONFIG_CMD_SF_TEST=y
CONFIG_SPL_DM_MMC=y
CONFIG_SPL_MMC=y
CONFIG_SPL_NET=y
CONFIG_SPL_SPI=y
CONFIG_SPL_FS_FAT=y
CONFIG_SPL_FS_EXT4=y
CONFIG_CRC32_VERIFY=y
CONFIG_CMD_TEMPERATURE=y
CONFIG_DM_THERMAL=y
CONFIG_STARFIVE_TEMPERATURE=y
CONFIG_MISC=y
CONFIG_CMD_MISC=y
CONFIG_STARFIVE_VOLTAGE=y
CONFIG_STARFIVE_CAN=y
CONFIG_SUPPORT_EMMC_RPMB=y
CONFIG_SYS_MMCSD_FS_BOOT_PARTITION=2
CONFIG_SPL_SPI_FLASH_TINY=n
CONFIG_STARFIVE_JHB100_SECURE_VAB_AUTH=y
CONFIG_CLK_STARFIVE_JHB100_SYS=y
CONFIG_CLK_STARFIVE_JHB100_PER0=y
CONFIG_CLK_STARFIVE_JHB100_PER1=y
CONFIG_CLK_STARFIVE_JHB100_PER2=y
CONFIG_CLK_STARFIVE_JHB100_PER3=y
CONFIG_SF_DEFAULT_BUS=1
```

## drivers/clk/starfive/Kconfig
```kconfig
# SPDX-License-Identifier: GPL-2.0+

config SPL_CLK_JH7110
	bool "SPL clock support for JH7110"
	depends on STARFIVE_JH7110 && SPL
	select SPL_CLK
	select SPL_CLK_CCF
	help
	  This enables SPL DM support for clock driver in JH7110.

config CLK_JH7110
	bool "StarFive JH7110 clock support"
	depends on STARFIVE_JH7110
	select CLK
	select CLK_CCF
	help
	  This enables support clock driver for StarFive JH7110 SoC platform.

config CLK_STARFIVE_COMMON
	bool
	select SPL_CLK_CCF
	select SPL_CLK_COMPOSITE_CCF
	select CLK_CCF
	select CLK_COMPOSITE_CCF

config CLK_STARFIVE_JHB100_AUTO_ENABLE
	bool "Auto-enable all StarFive JHB100 gated clocks at probe"
	depends on CLK_STARFIVE_COMMON
	default n
	help
	  Say yes here to have every gated clock (CLK_GATE, CLK_GDIV,
	  CLK_GMUX, CLK_COMPOSITE) automatically enabled as soon as its
	  clock domain driver probes, instead of waiting for a consumer
	  driver to request and enable it explicitly.

config CLK_STARFIVE_JHB100_SYS
	bool "StarFive JHB100 System clock support"
	depends on CLK
	select CLK_STARFIVE_COMMON
	help
	  Say yes here to support the System clock controller
	  on the StarFive JHB100 SoC.

config CLK_STARFIVE_JHB100_PER0
	bool "StarFive JHB100 Peripheral-0 clock support"
	depends on CLK_STARFIVE_JHB100_SYS
	help
	  Say yes here to support Peripheral-0 Clock Driver
	  on the StarFive JHB100 SoC.

config CLK_STARFIVE_JHB100_PER1
	bool "StarFive JHB100 Peripheral-1 clock support"
	depends on CLK_STARFIVE_JHB100_SYS
	help
	  Say yes here to support Peripheral-1 Clock Driver
	  on the StarFive JHB100 SoC.

config CLK_STARFIVE_JHB100_PER2
	bool "StarFive JHB100 Peripheral-2 clock support"
	depends on CLK_STARFIVE_JHB100_SYS
	help
	  Say yes here to support Peripheral-2 Clock Driver
	  on the StarFive JHB100 SoC.

config CLK_STARFIVE_JHB100_PER3
	bool "StarFive JHB100 Peripheral-3 clock support"
	depends on CLK_STARFIVE_JHB100_SYS
	help
	  Say yes here to support Peripheral-3 Clock Driver
	  on the StarFive JHB100 SoC.

config CLK_STARFIVE_JHB100_USB
	bool "StarFive JHB100 Universal-Serial-Bus clock support"
	depends on CLK_STARFIVE_JHB100_SYS
	help
	  Say yes here to support the Universal-Serial-Bus clock controller
	  on the StarFive JHB100 SoC.

config CLK_STARFIVE_JHB100_CPU
	bool "StarFive JHB100 CPU clock support"
	depends on CLK_STARFIVE_JHB100_SYS
	help
	  Say yes here to support the CPU clock controller
	  on the StarFive JHB100 SoC.

config CLK_STARFIVE_JHB100_VOUT
	bool "StarFive JHB100 VOUT clock support"
	depends on CLK
	select CLK_STARFIVE_COMMON
	help
	  Say yes here to support the VOUT (Video Output)
	  clock controller on the StarFive JHB100 SoC.
```

## drivers/mailbox/rpmi/Kconfig
```kconfig
config DM_RPMI_SRV_GRP
	bool "Enable RPMI service group using Driver Model"
	depends on DM && OF_CONTROL
	help
	  Enable support for the RPMI service group. This allows user to create a service group
	  and register its services to communicate through RPMI protocol via the mailbox channels.

config RPMI_SHMEM_MBOX
	bool "Enable RPMI mailbox shmem controller support"
	depends on SPL_DM_MAILBOX && RISCV && SPL_DM_RPMI_SRV_GRP
	help
	  This enables support for the RPMI mailbox shmem controller support, which
	  implements doorbells between 2 processors.

config RPMI_STARFIVE_SEC_SERVICE_RUNTIME_GRP
    bool "Enable StarFive Secure Runtime Service group"
    depends on SPL_DM_RPMI_SRV_GRP && RPMI_SHMEM_MBOX
    help
        Enable support for StarFive secure runtime service group. This allows
        user to request secure services from L1 Firmware via mailbox secure channel
```

## drivers/phy/starfive/Kconfig
```kconfig
# SPDX-License-Identifier: GPL-2.0-only
#
# Phy drivers for StarFive platforms
#

config PHY_STARFIVE_INNO_ETH
	bool "Starfive Innosillicon SGMII ethernet PHY support"
	help
	  Enable this to support the Innosillicon SGMII/Serdes
	  ethernet PHY
```

## drivers/pinctrl/starfive/Kconfig
```kconfig
# SPDX-License-Identifier: GPL-2.0-only

config SPL_PINCTRL_STARFIVE_JH7110
	bool "Support Pinctrl and GPIO driver for StarFive JH7110 SoC in SPL"
	depends on  SPL_PINCTRL_FULL && STARFIVE_JH7110
	help
	  Enable support pinctrl and gpio driver for StarFive JH7110 in SPL.
	  Say yes here to support pin control on the StarFive RISC-V SoC.
	  This also provides an interface to the GPIO pins not used by other
	  peripherals supporting inputs, outputs, configuring pull-up/pull-down
	  and interrupts on input changes.

config PINCTRL_STARFIVE_JH7110
	bool "Pinctrl and GPIO driver for StarFive JH7110 SoC"
	depends on PINCTRL_FULL && STARFIVE_JH7110
	help
	  This selects the pinctrl driver for JH7110 starfive. Say yes here to
	  support pin control on the StarFive RISC-V SoC. This also provides an
	  interface to the GPIO pins not used by other peripherals supporting
	  inputs, outputs, configuring pull-up/pull-down and interrupts on
	  input changes.

config PINCTRL_STARFIVE_JHB100
	bool "Pinctrl and GPIO driver for StarFive JHB100 SoC"
	depends on PINCTRL_FULL && STARFIVE_JHB100
	help
	  This selects the pinctrl driver for JHB100 starfive.
```

## drivers/reset/starfive/Kconfig
```kconfig
# SPDX-License-Identifier: GPL-2.0-only

config RESET_STARFIVE
	bool "Reset driver for StarFive SoC"
	depends on DM_RESET
	help
	  Enable this if require support for reset driver for
	  StarFive SOC.

config RESET_STARFIVE_JHB100
	bool "Reset driver for StarFive JHB100 SoC"
	depends on  RESET_STARFIVE
	help
	  This selects the reset driver for StarFive JHB100 SOC.

config RESET_STARFIVE_JHB100_AUTO_DEASSERT
	bool "Auto-deassert all StarFive JHB100 reset lines at probe"
	depends on RESET_STARFIVE_JHB100
	default n
	help
	  Say yes here to have every reset line in a CRG domain
	  automatically deasserted as soon as that domain's reset
	  device probes, instead of waiting for a consumer driver to
	  request and deassert it explicitly.

	  This deasserts from dm_probe_devices(), which runs inside
	  dm_init_and_scan() while gd->timer is NULL and before
	  EVT_DM_POST_INIT_R binds riscv_timer. Deassert confirms via
	  readl_poll_timeout(), so TIMER_EARLY is required to keep
	  get_ticks() from panicking there.
```

## drivers/video/starfive/Kconfig
```kconfig
menu "StarFive Video and Display Support"
	depends on VIDEO || DISPLAY

config VIDEO_STARFIVE_JHB100_DC8000
	bool "StarFive JHB100 DC8000 display controller"
	depends on VIDEO
	help
	  Enable minimal DC8000 framebuffer output for the JHB100 SoC.
	  This driver configures the primary plane for ARGB8888 and hands
	  timing selection to the attached display device (e.g. DP).

config DISPLAY_STARFIVE_JHB100_DW_DP
	bool "StarFive JHB100 DWC DisplayPort transmitter"
	depends on DISPLAY
	help
	  Enable the JHB100 DWC DisplayPort transmitter driver. This provides
	  EDID readout and link training for an attached DP sink.

endmenu
```
