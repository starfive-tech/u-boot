// SPDX-License-Identifier: GPL-2.0 OR MIT
/*
 * Copyright (C) 2025 StarFive Technology Co., Ltd.
 * Copyright (C) 2025 Hal Feng <hal.feng@starfivetech.com>
 */

#include "starfive_visionfive2-u-boot.dtsi"
