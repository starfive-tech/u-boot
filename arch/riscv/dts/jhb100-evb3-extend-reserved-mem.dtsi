// SPDX-License-Identifier: GPL-2.0 OR MIT
/*
 * Copyright (c) 2025 StarFive Technology Co., Ltd.
 */

npu_reserved_cache: npu_memory@80000000 {
	reg = <0x0 0x80000000 0x0 0x08000000>;
	no-map;
};

npu_reserved_uncache: npu_memory@440000000 {
	compatible = "shared-dma-pool";
	reg = <0x4 0x40000000 0x0 0x08000000>;
	no-map;
};
